## boards/enjoy_digital/litex_cv32e41p/Kconfig.litex_cv32e41p
```kconfig
# Copyright (c) 2018 - 2019 Antmicro <www.antmicro.com>
# SPDX-License-Identifier: Apache-2.0
# select SERIAL_SUPPORT_INTERRUPT
# select SERIAL

config BOARD_LITEX_CV32E41P
	select SOC_LITEX_CV32E41P
```

## boards/enjoy_digital/litex_cv32e41p/litex_cv32e41p_defconfig
```kconfig
#
# Copyright (c) 2019 Antmicro <www.antmicro.com>
#
# SPDX-License-Identifier: Apache-2.0
#

CONFIG_CONSOLE=y
CONFIG_SERIAL=y
CONFIG_UART_CONSOLE=y
CONFIG_GPIO=y
CONFIG_XIP=n
CONFIG_CLOCK_CONTROL=y
CONFIG_HEAP_MEM_POOL_SIZE=4096
#CONFIG_UART_INTERRUPT_DRIVEN=n
# CONFIG_LITEX_TIMER=y
#CONFIG_UART_LITEUART=y
CONFIG_GEN_IRQ_VECTOR_TABLE=y
#CONFIG_DYNAMIC_INTERRUPTS
```

## boards/enjoy_digital/litex_cva6/Kconfig.defconfig
```kconfig
# Copyright (c) 2018 - 2019 Antmicro <www.antmicro.com>
# SPDX-License-Identifier: Apache-2.0

if BOARD_LITEX_CVA6

if NETWORKING

config NET_L2_ETHERNET
	default y

endif # NETWORKING

endif # BOARD_LITEX_CVA6
```

## boards/enjoy_digital/litex_cva6/Kconfig.litex_cva6
```kconfig
# Copyright (c) 2018 - 2019 Antmicro <www.antmicro.com>
# SPDX-License-Identifier: Apache-2.0

config BOARD_LITEX_CVA6
	select SOC_LITEX_CVA6
```

## boards/enjoy_digital/litex_cva6/litex_cva6_defconfig
```kconfig
#
# Copyright (c) 2019 Antmicro <www.antmicro.com>
#
# SPDX-License-Identifier: Apache-2.0
#

CONFIG_CONSOLE=y
CONFIG_SERIAL=y
CONFIG_UART_CONSOLE=y
CONFIG_GPIO=y
CONFIG_XIP=n
CONFIG_CLOCK_CONTROL=n
```

## dts/bindings/cpu/litex,cv32e41p-standard.yaml
```yaml
# Copyright (c) 2024 Antmicro <www.antmicro.com>
#
# SPDX-License-Identifier: Apache-2.0

description: cv32e41p core with the standard configuration as used by LiteX

compatible: "litex,cv32e41p-standard"

include: riscv,cpus.yaml
```

## dts/bindings/interrupt-controller/cv32e41p-intc0.yaml
```yaml
# Copyright (c) 2018 - 2019 Antmicro <www.antmicro.com>
# SPDX-License-Identifier: Apache-2.0

description: LiteX cv32e41p interrupt controller

compatible: "cv32e41p-intc0"

include: [interrupt-controller.yaml, base.yaml]

properties:
  reg:
    required: true

  riscv,max-priority:
    type: int
    description: maximum interrupt priority
    required: true

  "#interrupt-cells":
    const: 2

interrupt-cells:
  - irq
  - priority
```

## soc/litex/litex_cv32e41p/Kconfig.defconfig
```kconfig
# Copyright (c) 2018 - 2019 Antmicro <www.antmicro.com>
# SPDX-License-Identifier: Apache-2.0

if SOC_LITEX_CV32E41P

config SYS_CLOCK_HW_CYCLES_PER_SEC
	default 50000000


config NUM_IRQS
	default 32

endif # SOC_LITEX_CV32E41P
```

## soc/litex/litex_cv32e41p/Kconfig.soc
```kconfig
# Copyright (c) 2018 - 2019 Antmicro <www.antmicro.com>
# SPDX-License-Identifier: Apache-2.0

config SOC_LITEX_CV32E41P
	bool
	help
	  LiteX cv32e41p system implementation

config SOC
	default "litex_cv32e41p" if SOC_LITEX_CV32E41P
```

## soc/litex/litex_cva6/Kconfig
```kconfig
# Copyright (c) 2018 - 2019 Antmicro <www.antmicro.com>
# SPDX-License-Identifier: Apache-2.0

config SOC_LITEX_CVA6
	select RISCV
	select RISCV_PRIVILEGED
	select ATOMIC_OPERATIONS_BUILTIN
	select INCLUDE_RESET_VECTOR
	select RISCV_ISA_RV64I
	select RISCV_ISA_EXT_M
	select RISCV_ISA_EXT_A
	select RISCV_ISA_EXT_ZICSR
	select RISCV_ISA_EXT_ZIFENCEI
	select RISCV_HAS_PLIC
	select 64bits


if SOC_LITEX_CVA6

config LITEX_CSR_DATA_WIDTH
	int "Select Control/Status register width"
	default 32

endif # SOC_LITEX_CVA6
```

## soc/litex/litex_cva6/Kconfig.soc
```kconfig
# Copyright (c) 2018 - 2019 Antmicro <www.antmicro.com>
# SPDX-License-Identifier: Apache-2.0

config SOC_LITEX_CVA6
	bool
	help
	  LiteX CVA6 system implementation

config SOC
	default "litex_cva6" if SOC_LITEX_CVA6
```
